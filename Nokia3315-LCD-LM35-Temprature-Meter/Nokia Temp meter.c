#pragma config OSC = HS, OSCS = OFF
#pragma config PWRT= OFF , BOR=ON, BORV = 45
#pragma config WDT = OFF
#pragma config DEBUG = OFF ,LVP =OFF , STVR =OFF
#include <p18f458.h>
#define SCE PORTCbits.RC0
#define DC PORTCbits.RC1

char lookup(int );
void disp(float );
void spi(unsigned char );
void gotoXy(unsigned char ,unsigned char );
void lcdInit(void);
void clearLcd(void);
void blackLcd(void);
void delayMs(int x) ;
void lcdStr( char * ,unsigned char);
rom const char FONTLOOKUP [][5]= {
    { 0x00, 0x00, 0x00, 0x00, 0x00 },   /* space */
    { 0x00, 0x00, 0x2f, 0x00, 0x00 },   /* ! */
    { 0x00, 0x07, 0x00, 0x07, 0x00 },   /* " */
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    { 0x44, 0x64, 0x54, 0x4C, 0x44 }    /* z */
};

void main(void)
{ 
unsigned int i,h,l,z;
float f,p,tmpr;
char ddata[11];
SSPSTAT =0x40;
SSPCON1=0x22;


TRISC =0;
TRISAbits.TRISA0=1;
ADCON0= 0x89;
ADCON1= 0xC4;
lcdInit();
while(1)
{
ADCON0bits.GO=1;
while(ADCON0bits.DONE==1);
PORTB=ADRESL;
h=ADRESH;     //ADC result higher 2 bits
l=ADRESL;     //ADC result lower 8 bits
PIR1=PIR1&~64;  //ADC interrupt flag is cleared
z=h*0x100+l;       //combined 10 bit number formation
f=z;           //unsigned to float conversion
p=(f*5)/1023;    //equivalent voltage calculation from ADC output
tmpr=p*100;      //sensor output voltage to degree Celsius conversion
disp(tmpr);    //call of disp(float) to display the temperature
}
}
void disp(float num)
{
int x1,x2,x3,x4,n,temp;
 static float f1;
char ddata[12];
char ch1,ch2,ch3,ch4,dot='.';
n=num;
temp=num;
x1=n%10;
n=n/10;
x2=n%10;
n=n/10;
x3=n%10;
f1=num-temp;
x4=f1*10;


delayMs(1200);
clearLcd();
ddata[0]='T';
ddata[1]='E';
ddata[2]='M';
ddata[3]='P';
ddata[4]='=';
ddata[5]=lookup(x3);
ddata[6]=lookup(x2);
ddata[7]=lookup(x1);
ddata[8]='.';
ddata[9]=lookup(x4);
ddata[10]=' ';
ddata[11]='C';


gotoXy(1,2);
lcdStr(ddata,12);


}

char lookup(int no)
{
char cha;
switch(no)
{
case 0:
cha='0';
break;
case 1:
cha='1';
break;
case 2:
cha='2';
break;
case 3:
cha='3';
break;
case 4:
cha='4';
break;
case 5:
cha='5';
break;
case 6:
cha='6';
break;
case 7:
cha='7';
break;
case 8:
cha='8';
break;
case 9:
cha='9';
break;
}
return cha;
}













void spi(unsigned char myData)
{
SCE=0;
SSPBUF = myData;
while(!SSPSTATbits.BF);
SCE=1;
}

void lcdInit()
{
SCE=0;
DC=0;
spi(0x21);
spi(0xC8);
spi(0x06);
spi(0x13);
spi(0x20);
spi(0x0C);
spi(0x40);
spi(0x80);
clearLcd();
blackLcd();
}

void clearLcd()
{
int res;
SCE=0;
DC=1;
for(res=0;res<504;res++)
spi(0x00);
}
void blackLcd()
{
int res;
SCE=0;
DC=1;
for(res=0;res<504;res++)
{
spi(0xFF);
}
}

void gotoXy(unsigned char x,unsigned char y)
{
DC=0;
y=y|0x40;
spi(y);
x=(x*6)|0x80;
spi(x);
DC=1;
}

void lcdStr( char *str,unsigned char len)
{
int i;
DC=1;

for(;len>0;len --)
{
for(i=0;i<=4;i++)
spi(FONTLOOKUP[*str-32][i]);
spi(0x00);
str++;
}

}
void toLcd(char ch)
{
spi(FONTLOOKUP[ch][1]);
spi(FONTLOOKUP[ch][2]);
spi(FONTLOOKUP[ch][3]);
spi(FONTLOOKUP[ch][4]);
}
void delayMs(int x)              // a general delay function
{
int i;
	for (x ;x>0;x--)
	{
	for (i=0;i<=110;i++);
	}
}
  